## tests/kernel/mutex/mutex_api/testcase.yaml
```yaml
tests:
  kernel.mutex:
    tags: kernel userspace
  kernel.mutex.negative:
    tags: kernel userspace
    extra_args: NEGATIVE_CASE=1
```

## tests/kernel/threads/negative/testcase.yaml
```yaml
tests:
  kernel.threads.negative:
    tags: kernel threads userspace ignore_faults
    min_flash: 34
```
